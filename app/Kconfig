## app/Kconfig
```kconfig
# Copyright (c) 2024 The ZMK Contributors
# SPDX-License-Identifier: MIT

rsource "src/studio/Kconfig"

config ZMK_BEHAVIOR_STUDIO_UNLOCK
    bool
    default y
    depends on DT_HAS_ZMK_BEHAVIOR_STUDIO_UNLOCK_ENABLED && ZMK_STUDIO
```

## boards/arm/cosmos_lemon_wireless/Kconfig.cosmos_lemon_wireless
```kconfig
# SPDX-License-Identifier: MIT

config BOARD_COSMOS_LEMON_WIRELESS
    select SOC_NRF52840_QIAA
    select ZMK_BOARD_COMPAT
```

## boards/arm/cosmos_lemon_wireless/Kconfig.defconfig
```kconfig
# SPDX-License-Identifier: MIT

if BOARD_COSMOS_LEMON_WIRELESS

config USB_NRFX
    default y

endif # BOARD_COSMOS_LEMON_WIRELESS
```

## boards/arm/cosmos_lemon_wireless/board.yml
```yaml
board:
  name: cosmos_lemon_wireless
  full_name: Cosmos Lemon Wireless
  vendor: others
  socs:
    - name: nrf52840
```

## boards/shields/cosmotyl/Kconfig.defconfig
```kconfig
if SHIELD_cosmotyl_LEFT

config ZMK_KEYBOARD_NAME
    default "cosmotyl"

endif # SHIELD_cosmotyl_LEFT

if SHIELD_cosmotyl_RIGHT

config ZMK_KEYBOARD_NAME
    default "cosmotyl"

config ZMK_SPLIT_ROLE_CENTRAL
    default y

config ZMK_TRACKPAD_LOGICAL_X
    default 1050

config ZMK_TRACKPAD_LOGICAL_Y
    default 1250

config ZMK_TRACKPAD_PHYSICAL_X
    default 420

config ZMK_TRACKPAD_PHYSICAL_Y
    default 500

config PS2
    default y

config PS2_UART
    default y

config ZMK_MOUSE_PS2
    default y

endif # SHIELD_cosmotyl_RIGHT

if SHIELD_cosmotyl_LEFT || SHIELD_cosmotyl_RIGHT

config ZMK_SPLIT
    default y

config SPI
    default y

config I2C
    default y

config ZMK_RGB_UNDERGLOW
    select WS2812_STRIP
    select SPI

endif # SHIELD_cosmotyl_LEFT || SHIELD_cosmotyl_RIGHT
```

## boards/shields/wav50/Kconfig.defconfig
```kconfig
if SHIELD_wav50_RIGHT

config ZMK_KEYBOARD_NAME
    default "wav50"

config ZMK_SPLIT_ROLE_CENTRAL
    default y

endif # SHIELD_wav50_RIGHT

if SHIELD_wav50_LEFT || SHIELD_wav50_RIGHT

config ZMK_SPLIT
    default y

endif # SHIELD_wav50_LEFT || SHIELD_wav50_RIGHT
```

## boards/shields/wav50/Kconfig.shield
```kconfig
config SHIELD_wav50_LEFT
    def_bool $(shields_list_contains,wav50_left)

config SHIELD_wav50_RIGHT
    def_bool $(shields_list_contains,wav50_right)
```

## boards/shields/wav50hz/Kconfig.defconfig
```kconfig
# Right side is central (PS/2 TrackPoint is on the right)
if SHIELD_wav50hz_RIGHT

config ZMK_KEYBOARD_NAME
    default "Wav50hz"

config ZMK_SPLIT_ROLE_CENTRAL
    default y

endif # SHIELD_wav50hz_RIGHT

if SHIELD_wav50hz_LEFT || SHIELD_wav50hz_RIGHT

config ZMK_SPLIT
    default y

config SPI
    default y

config ZMK_RGB_UNDERGLOW
    select WS2812_STRIP
    select SPI

endif # SHIELD_wav50hz_LEFT || SHIELD_wav50hz_RIGHT
```

## boards/shields/wav50hz/Kconfig.shield
```kconfig
config SHIELD_wav50hz_LEFT
    def_bool $(shields_list_contains,wav50hz_left)

config SHIELD_wav50hz_RIGHT
    def_bool $(shields_list_contains,wav50hz_right)
```

## config/west.yml
```yaml
manifest:
  remotes:
    - name: zmkfirmware
      url-base: https://github.com/zmkfirmware
    - name: petejohanson
      url-base: https://github.com/petejohanson
    - name: george-norton
      url-base: https://github.com/george-norton
  projects:
    - name: zmk
      remote: petejohanson
      revision: 73c0fdc6bf0d7777699686dd21d9bd2fd117c0e3
      import: app/west.yml
    - name: maxtouch-zephyr-module
      remote: george-norton
      revision: main
  self:
    path: config
    import: deps.yml
```
